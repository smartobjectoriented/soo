## agency/linux/drivers/net/ethernet/cadence_ethercat/Kconfig
```kconfig
# SPDX-License-Identifier: GPL-2.0-only
#
# Cadence device configuration
#

config MACB_ETHERCAT
	tristate "Cadence MACB/GEM support - EtherCAT"
	depends on HAS_DMA && COMMON_CLK
	select PHYLINK
	select CRC32
	depends on NET_VENDOR_CADENCE
	help
	  The Cadence MACB ethernet interface is found on many Atmel AT32 and
	  AT91 parts.  This driver also supports the Cadence GEM (Gigabit
	  Ethernet MAC found in some ARM SoC devices).  Say Y to include
	  support for the MACB/GEM chip.

	  To compile this driver as a module, choose M here: the module
	  will be macb.

config MACB_USE_HWSTAMP_ETHERCAT
	bool "Use IEEE 1588 hwstamp"
	depends on MACB_ETHERCAT
	depends on PTP_1588_CLOCK
	default y
	help
	  Enable IEEE 1588 Precision Time Protocol (PTP) support for MACB.

config MACB_PCI_ETHERCAT
	tristate "Cadence PCI MACB/GEM support"
	depends on MACB_ETHERCAT && PCI
	help
	  This is PCI wrapper for MACB driver.

	  To compile this driver as a module, choose M here: the module
	  will be called macb_pci.
```

## agency/linux/drivers/net/wireless/marvell/Kconfig
```kconfig
config WLAN_VENDOR_MARVELL
	bool "Marvell devices"
	default y
	---help---
	  If you have a wireless card belonging to this class, say Y.

	  Note that the answer to this question doesn't directly affect the
	  kernel: saying N will just cause the configurator to skip all the
	  questions about these cards. If you say Y, you will be asked for
	  your specific card in the following questions.

if WLAN_VENDOR_MARVELL

source "drivers/net/wireless/marvell/libertas/Kconfig"
source "drivers/net/wireless/marvell/libertas_tf/Kconfig"
source "drivers/net/wireless/marvell/mwifiex/Kconfig"

config MWL8K
	tristate "Marvell 88W8xxx PCI/PCIe Wireless support"
	depends on MAC80211 && PCI
	---help---
	  This driver supports Marvell TOPDOG 802.11 wireless cards.

	  To compile this driver as a module, choose M here: the module
	  will be called mwl8k.  If unsure, say N.

# SOO.tech
# +MARVELL_MWIFIEX_MLAN +MARVELL_MWIFIEX_MOAL
config MARVELL_MWIFIEX_MLAN
	bool "Marvell mlan core"

config MARVELL_MWIFIEX_MOAL
	bool "Marvell linux control abstraction layer"

	---help---
	  This adds support for wireless adapters based on Marvell
	  802.11n/ac chipsets.

	  If you choose to build it as a module, it will be called
	  mwifiex.
	
# SOO.tech
# This option selects WIRELESS_EXT and WEXT_PRIV, which should be enabled
# if you are planning to use iwpriv. Please note that the WEXT features
# are mutually exclusive with the CFG80211 ones, that is, you will not be
# able to use iw if MARVELL_WEXT is enabled.
config MARVELL_WEXT
	bool "Wireless extensions for Marvell"
	select WIRELESS_EXT
	select WEXT_PRIV

endif # WLAN_VENDOR_MARVELL
```

## agency/linux/kernel/ipipe/Kconfig
```kconfig
config IPIPE
	bool "Interrupt pipeline"
	default y
	help
	  Activate this option if you want the interrupt pipeline to be
	  compiled in.

config IPIPE_CORE
	def_bool y if IPIPE

config IPIPE_WANT_CLOCKSOURCE
       bool

config IPIPE_WANT_PTE_PINNING
       bool


config IPIPE_HAVE_HOSTRT
       bool

config IPIPE_HAVE_PIC_MUTE
       bool


config IPIPE_HAVE_SAFE_THREAD_INFO
	bool

config IPIPE_HAVE_VM_NOTIFIER
	bool
```

## agency/linux/kernel/xenomai/Kconfig
```kconfig
menu "Sizes and static limits"

config XENO_OPT_REGISTRY_NRSLOTS
	int "Number of registry slots"
	default 512
	help
	The registry is used by the Cobalt kernel to export named
	resources to user-space programs via the /proc interface.
	Each named resource occupies a registry slot. This option sets
	the maximum number of resources the registry can handle.

config XENO_OPT_SYS_HEAPSZ
	int "Size of system heap (Kb)"
	default 512
	help
	The system heap is used for various internal allocations by
	the Cobalt kernel. The size is expressed in Kilobytes.


endmenu
```

## agency/linux/opencn/Kconfig
```kconfig
menu "OpenCN (AMP) Framework"

config RTDM_HZ
	int "Timer Frequency simulation"
	default 250
	help
		Simulation of the Timer frequency. It is used by EtherCAT master

config OPENCN_RTS_TOGGLE
	bool "RTS Toggle latency test"
	help
		Toggle RTS pin
	default N

source "opencn/master/Kconfig"

config OPENCN_BECKHOFF_APP
    bool "Beckhoff testing application"
    help
        This app works with the Beckhoff in/out modules.
    depends on OPENCN_ETHERCAT_MASTER

config OPENCN_OPENBLAS
	bool "OpenBLAS"

config VDUMMY_RING
	bool "vdummy ring buffer"

config OPENCN_COMPANION
	bool "OpenCN Companion EtherCAT Slave"
	help
        Build the OpenCN as Companion Slave
    depends on PWM && ARCH_BCM2835 && PWM_BCM2835

endmenu # OpenCN
```
