## ME/SOO.agency/so3/soo/drivers/Kconfig
```kconfig
#
# SOO Mobile Entity configuration
#

menu "SOO Mobile Entity frontend drivers"

config VUART_FRONTEND
	bool "vuart serial driver"

endmenu
```

## ME/SOO.blind/so3/apps/Kconfig
```kconfig
menu "SO3 Applications"

	config APP_DEFAULT
		bool "Default application with thread environment"
	
endmenu
```

## ME/SOO.blind/so3/soo/drivers/Kconfig
```kconfig
#
# SOO Mobile Entity configuration
#

menu "SOO Mobile Entity frontend drivers"

config VUART_FRONTEND
	bool "vuart serial driver"

config VDOGA12V6NM_FRONTEND
	bool "vDoga12v6nm frontend for the DOGA 12V 6Nm blind motor"

config VUIHANDLER_FRONTEND
	bool "vuihandler UI manager driver"

endmenu
```

## ME/SOO.net/so3/arch/arm/Kconfig
```kconfig
choice
  prompt "SO3 OS type"
	
	config SO3VIRT
		bool "SO3 virtshare/avz"
		depends on MMU

	config STANDALONE
		bool "SO3 standalone environment"
        
   
endchoice
```

## ME/SOO.net/so3/soo/drivers/vnetfront/Kconfig
```kconfig
#
# SOO device configuration
#


menu "vnet backend config"

choice VNET_BACKEND_ARCH
    prompt "Backend architecture"
    depends on VNET_FRONTEND
    default VNET_BACKEND_ARCH_BRIDGE_AND_NAT

config VNET_BACKEND_ARCH_BRIDGE
    bool "Use bridge architectue"
    help
      All virtual interfaces are grouped in a single bridge with the outgoing interface (ex: eth0).

config VNET_BACKEND_ARCH_BRIDGE_AND_NAT
    bool "Use bridge and NAT architectue"
    help
        All virtual interfaces are grouped in a single bridge without the outgoing interface. A NAT give access to the internet.

config VNET_BACKEND_ARCH_NAT
    bool "Use NAT only architectue"
    depends on VNET_FRONTEND
    help
        Each virtual interface has it's own network. Can't be used with migrant ME. A NAT give access to the internet.


endchoice


config VNET_FRONT_DHCP
    bool "Use DHCP"
    help
      The me use DHCP to acquire IP


endmenu
```

## ME/SOO.net/target/so3virt_ramfs.its
```
/*
 * Copyright (C) 2018-2019 Daniel Rossier <daniel.rossier@soo.tech>
 *
 * This program is free software; you can redistribute it and/or modify
 * it under the terms of the GNU General Public License version 2 as
 * published by the Free Software Foundation.
 *
 * This program is distributed in the hope that it will be useful,
 * but WITHOUT ANY WARRANTY; without even the implied warranty of
 * MERCHANTABILITY or FITNESS FOR A PARTICULAR PURPOSE.  See the
 * GNU General Public License for more details.
 *
 * You should have received a copy of the GNU General Public License
 * along with this program; if not, write to the Free Software
 * Foundation, Inc., 51 Franklin St, Fifth Floor, Boston, MA  02110-1301  USA
 *
 */

/dts-v1/;

/ {
	description = "SO3 image containing so3 kernel and FDT blob (including rootfs)";
	#address-cells = <0>;
	#size-cells = <0>;
	
	images {
		#address-cells = <0>;
		#size-cells = <0>;
		kernel {
			/*reg = <>; Make dtc happy ;-) */
			description = "SO3 OS kernel";
			data = /incbin/("../so3/so3.bin");
			type = "kernel";
			arch = "arm";
			os = "linux";
			compression = "none";
			
			#address-cells = <0>;
			#size-cells = <0>;
			
			hash {
				algo = "crc32";
			};
		};
		fdt {
			description = "Flattened Device Tree blob";
			data = /incbin/("../so3/arch/arm/boot/dts/so3virt.dtb");
			type = "flat_dt";
			arch = "arm";
			compression = "none";
			hash {
				algo = "crc32";
			};
		};	

                ramdisk {
                        description = "SO3 environment minimal rootfs";
                        data = /incbin/("../rootfs/board/so3virt/rootfs.fat");
                        type = "ramdisk";
                        arch = "arm";
                        os = "linux";
                        compression = "none";
                };

    };
	configurations {
		default = "conf";
		conf {
			description = "SO3 kernel image including device tree";
			kernel = "kernel";
			fdt = "fdt";
                        ramdisk = "ramdisk";
		};
	};
};
```

## ME/SOO.outdoor/so3/arch/arm/Kconfig
```kconfig
menu "Platform"

choice
	prompt "SO3 OS type"

config STANDALONE
        bool "Standalone OS"
        
endchoice

choice
  prompt "Target"
	
       	depends on STANDALONE
	config SO3VIRT
		bool "SO3 virtshare/avz"
		depends on MMU
        
   
endchoice

endmenu
```

## ME/SOO.outdoor/so3/soo/Kconfig
```kconfig
#
# SOO Mobile Entity configuration
#

menu "SOO Mobile Entity - Smart Object Oriented subsystem"
source "soo/drivers/Kconfig"
endmenu
```

## ME/SOO.outdoor/so3/soo/drivers/Kconfig
```kconfig
#
# SOO Mobile Entity configuration
#

menu "SOO Mobile Entity frontend drivers"

config VUART_FRONTEND
	bool "vuart serial driver"

config VWEATHER_FRONTEND
	bool "vWeather frontend for the SOO.outdoor weather station"

config VUIHANDLER_FRONTEND
	bool "vuihandler UI manager driver"

endmenu
```

## ME/SOO.refso3/so3/apps/Kconfig
```kconfig
menu "SO3 Applications"

	config NETSTREAM_MESSAGING
		bool "Netstream messaging functionalities"
		depends on VNETSTREAM_FRONTEND

	config APP_TEST_MALLOC
		bool "malloc() stress test application"
	
	config APP_DEFAULT
		bool "Default application with thread environment"
	
endmenu
```

## ME/SOO.refso3/so3/devices/Kconfig
```kconfig
menu "Drivers"

config UART
	bool "Driver UART"
	
source "devices/serial/Kconfig"
source "devices/ramdev/Kconfig"
source "devices/timer/Kconfig"
source "devices/irq/Kconfig"


endmenu
```

## ME/SOO.refso3/so3/devices/fb/Kconfig
```kconfig
config PL111_CLCD
	bool "PL111 CLCD framebuffer device"
	depends on VEXPRESS

config SO3VIRT_FB
	bool "Virtual framebuffer driver"
	depends on SO3VIRT
```

## ME/SOO.refso3/so3/devices/input/Kconfig
```kconfig
config PL050_KMI
	bool "PL050 Keyboard/Mouse Interface"
	depends on VEXPRESS

config SO3VIRT_INPUT
	bool "Virtual input driver"
	depends on SO3VIRT
```

## ME/SOO.refso3/so3/devices/serial/Kconfig
```kconfig
config SO3VIRT_SERIAL
	bool "SO3VIRT serial driver (rely on vuart frontend)"
	depends on SO3VIRT
	
	
```

## ME/SOO.refso3/so3/soo/drivers/Kconfig
```kconfig
#
# SOO Mobile Entity configuration
#

menu "SOO Mobile Entity frontend drivers"

config VDUMMY_FRONTEND
        bool "vdummy Dummy driver support debugging and testing"

config VUART_FRONTEND
	bool "vuart serial driver"

config VDOGA12V6NM_FRONTEND
	bool "vDoga12v6nm frontend for the DOGA 12V 6Nm blind motor"

config VWEATHER_FRONTEND
	bool "vWeather frontend for the SOO.outdoor weather station"

config VUIHANDLER_FRONTEND
	bool "vuihandler UI manager driver"

config VENOCEAN_FRONTEND
	bool "venocean UI FE"
    default y

endmenu
```

## ME/base/so3/arch/arm/Kconfig
```kconfig
menu "Platform"

choice
	prompt "SO3 OS type"

config STANDALONE
        bool "Standalone OS"
        
endchoice

choice
  prompt "Target"
	
		config VEXPRESS
    		bool "Vexpress"
        
        config RPI4
        	bool "Raspberry Pi 4 B"
        
        config SO3VIRT
			bool "SO3 avz"
			depends on MMU
   
endchoice

source "arch/arm/vexpress/Kconfig"
source "arch/arm/merida/Kconfig"
source "arch/arm/bpi/Kconfig"
source "arch/arm/rpi4/Kconfig"

endmenu
```

## ME/base/so3/arch/arm32/Kconfig
```kconfig
if ARCH_ARM32

menu "Platform"

choice
  prompt "Target"
	
	config VEXPRESS
    		bool "Vexpress"
	
	config RPI4    	
    		bool "Raspberry Pi 4 Model B support"
     
	config SO3VIRT
		bool "SO3 avz"
		depends on MMU
endchoice


source "arch/arm32/vexpress/Kconfig"
source "arch/arm32/rpi4/Kconfig"

endmenu

endif
```

## ME/base/so3/devices/irq/Kconfig
```kconfig
config GIC
	bool "Generic IRQ Controller"

config VIRQ 
	bool "Virtual IRQ Controller"
	
	
```

## ME/base/so3/soo/Kconfig
```kconfig
#
# SOO Mobile Entity configuration
#

menu "SOO Mobile Entity - Smart Object Oriented subsystem"

config VBSTORE_VADDR
	hex "Virtual base address of the VBstore shared page"

source "soo/me/Kconfig"
source "soo/drivers/Kconfig"

endmenu
```
