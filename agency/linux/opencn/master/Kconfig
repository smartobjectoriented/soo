## agency/target/vexpress/vexpress_tz.its
```
/*
 * Copyright (C) 2019 Daniel Rossier <daniel.rossier@soo.tech>
 *
 * This program is free software; you can redistribute it and/or modify
 * it under the terms of the GNU General Public License version 2 as
 * published by the Free Software Foundation.
 *
 * This program is distributed in the hope that it will be useful,
 * but WITHOUT ANY WARRANTY; without even the implied warranty of
 * MERCHANTABILITY or FITNESS FOR A PARTICULAR PURPOSE.  See the
 * GNU General Public License for more details.
 *
 * You should have received a copy of the GNU General Public License
 * along with this program; if not, write to the Free Software
 * Foundation, Inc., 51 Franklin St, Fifth Floor, Boston, MA  02110-1301  USA
 *
 */

/dts-v1/;

/ {
	description = "SOO Agency components for vExpress environment";

	images {
        
                avz {
			description = "AVZ Hypervisor (32-bit)";
                        data = /incbin/("../../avz/avz.bin");
			type = "kernel";
                        os = "linux";
			arch = "arm";
			compression = "none";
			load = <0x80008000>;
			entry = <0x80008000>;
		};
        
		agency {
			description = "Agency Linux kernel";
			data = /incbin/("../../linux/arch/arm/boot/Image");
			type = "kernel";
			arch = "arm";
			os = "linux";
			compression = "none";
			load = <0x80c08000>;
			entry = <0x80c08000>;

			hash {
				algo = "crc32";
			};
		};
			
       fdt {
			description = "SOO Agency device tree blob";
			data = /incbin/("../../linux/arch/arm/boot/dts/vexpress-tz.dtb");
			type = "flat_dt";
			arch = "arm";
			compression = "none";
			
			load = <0x9e000000>;
			hash {
				algo = "crc32";
			};
		};
	
		initrd {
			description = "Agency initial rootfs (initrd)";
			data = /incbin/("../../rootfs/board/vexpress/initrd.cpio");
			type = "ramdisk";
			arch = "arm";
			os = "linux";
			compression = "none";
			load = <0x9f000000>;
			
			hash {
				algo = "crc32";
			};
		};
	};
	
	configurations {
		default = "conf";
		conf {
			description = "SOO Agency on vExpress";
            loadables = "agency";
            kernel = "avz";
            fdt = "fdt";
            ramdisk = "initrd";
		};
	};
};
```

## agency/target/virt64.its
```
/*
 * Copyright (C) 2020 Daniel Rossier <daniel.rossier@heig-vd.ch>
 *
 * This program is free software; you can redistribute it and/or modify
 * it under the terms of the GNU General Public License version 2 as
 * published by the Free Software Foundation.
 *
 * This program is distributed in the hope that it will be useful,
 * but WITHOUT ANY WARRANTY; without even the implied warranty of
 * MERCHANTABILITY or FITNESS FOR A PARTICULAR PURPOSE.  See the
 * GNU General Public License for more details.
 *
 * You should have received a copy of the GNU General Public License
 * along with this program; if not, write to the Free Software
 * Foundation, Inc., 51 Franklin St, Fifth Floor, Boston, MA  02110-1301  USA
 *
 */

/dts-v1/;

/ {
	description = "Kernel and rootfs components for virt64 (armv8) environment";

	images {
        
        avz {
			description = "AVZ Hypervisor (64-bit)";
            data = /incbin/("../avz/avz.bin");
			type = "kernel";
            os = "linux";
			arch = "arm64";
			compression = "none";
			load = <0x40080000>;
			entry = <0x40080000>;
		};


		linux {
			description = "Linux kernel";
			data = /incbin/("../linux/arch/arm64/boot/Image");
			type = "agency";
			arch = "arm64";
			os = "linux";
			compression = "none";
			load = <0x41080000>;
			entry = <0x41080000>;
		};

        fdt {
			description = "Linux device tree blob";
			data = /incbin/("../linux/arch/arm64/boot/dts/arm/virt64.dtb");
			type = "flat_dt";
			arch = "arm64";
			compression = "none";
			load = <0x50a00000>;
		};

		initrd {
			description = "Initial rootfs (initrd)";
			data = /incbin/("../rootfs/board/virt64/initrd.cpio");
			type = "ramdisk";
			arch = "arm64";
			os = "linux";			
			compression = "none";
			load = <0x50c00000>;
		};
	};

	configurations {
		default = "agency";
		
		agency {
			description = "SOO Agency on virt64";
		    kernel = "avz";
            loadables = "linux"; 
             fdt = "fdt"; 
             ramdisk = "initrd"; 
		};
		
	};

};
```

## agency/target/virt64/virt64.its
```
/*
 * Copyright (C) 2020 Daniel Rossier <daniel.rossier@heig-vd.ch>
 *
 * This program is free software; you can redistribute it and/or modify
 * it under the terms of the GNU General Public License version 2 as
 * published by the Free Software Foundation.
 *
 * This program is distributed in the hope that it will be useful,
 * but WITHOUT ANY WARRANTY; without even the implied warranty of
 * MERCHANTABILITY or FITNESS FOR A PARTICULAR PURPOSE.  See the
 * GNU General Public License for more details.
 *
 * You should have received a copy of the GNU General Public License
 * along with this program; if not, write to the Free Software
 * Foundation, Inc., 51 Franklin St, Fifth Floor, Boston, MA  02110-1301  USA
 *
 */

/dts-v1/;

/ {
	description = "Kernel and rootfs components for virt64 (armv8) environment";

	images {
             
		linux {
			description = "Linux kernel";
			data = /incbin/("../../linux/arch/arm64/boot/Image");
			type = "kernel";
			arch = "arm";
			os = "linux";
			compression = "none";
			load = <0x40080000>;
			entry = <0x40080000>;
		};

        fdt_linux {
			description = "Linux device tree blob";
			data = /incbin/("virt.dtb");
			type = "flat_dt";
			arch = "arm";
			compression = "none";
			load = <0x48000000>;
		};

		initrd {
			description = "Initial rootfs (initrd)";
			data = /incbin/("../../rootfs/board/vexpress/initrd.cpio");
			type = "ramdisk";
			arch = "arm";
			os = "linux";			
			compression = "none";
			load = <0x5f000000>;
		};

	};
	

	configurations {
		default = "conf_linux";

		conf_linux {
			description = "Linux on virt64 (armv8)";
            kernel = "linux";
            fdt = "fdt_linux"; 
            /* ramdisk = "initrd"; */
		};
		
	};

};
```

## agency/usr/Kconfig
```kconfig
#
# For a description of the syntax of this configuration file,
# see Documentation/kbuild/kconfig-language.txt.
#
mainmenu "SOO Agency $KERNELVERSION User space Configuration"

menu "Agency subsystems"

source "core/Kconfig"

source "dcm/Kconfig"

source "apps/Kconfig"

source "lib/Kconfig"

source "apps/Kconfig"
endmenu
```

## agency/usr/apps/Kconfig
```kconfig
menuconfig WEATHER
    default n
	bool "Weather data parser (SOO.outdoor)"

config ASF_TA_TST
	bool "ASF TA test app"
	default n
	help
	   Application used to test ASF TA.
```

## agency/usr/core/Kconfig
```kconfig
menu "Agency Core Configuration"


config MIGRATION_CYCLE_FREQ
	int "Migration cycle frequency (in second)"	
	default 1
	help
	   Migration cycle currently expressed in s (second). It determines to which frequency all residing MEs enter a migration cycle.
	   
config LEDS
	bool "Support for debug with LEDs during migration"
	help
	   Migration can be monitored by means of specific LEDs (when a ME is received for example)
	   
endmenu
```

## agency/usr/lib/Kconfig
```kconfig
menu "Library Configuration"

config LZ4
	bool "lz4-r130 compression library"

endmenu
```

## buildroot/package/apt/Config.in
```kconfig
config BR2_PACKAGE_APT
	bool "apt"
	help
	  APT Package Manager

	  https://github.com/lipnitsk/libcue
```

## buildroot/package/clp/Config.in
```kconfig
config BR2_PACKAGE_CLP
	bool "clp"
	depends on BR2_PACKAGE_HOST_PKGCONF
	select BR2_PACKAGE_COINUTILS
	select BR2_PACKAGE_OPENBLAS
	select BR2_PACKAGE_LAPACK
	select BR2_PACKAGE_GLPK
	select BR2_PACKAGE_BZIP2

	help
	  Clp (Coin-or linear programming) is an open-source linear programming solver.

	  https://github.com/coin-or/Clp
```

## buildroot/package/coinutils/Config.in
```kconfig
config BR2_PACKAGE_COINUTILS
	bool "CoinUtils"
	help
	  CoinUtils (Coin-OR Utilities) is an open-source collection of classes and functions that are generally useful to more than one COIN-OR project.

	  https://github.com/coin-or/CoinUtils
```
