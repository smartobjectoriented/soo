## agency/linux/opencn/master/Kconfig
```kconfig
config OPENCN_ETHERCAT_MASTER
    bool "EtherCAT master"
    help
        Build EtherCat master component
    default N


if OPENCN_ETHERCAT_MASTER

config OPENCN_ETHERCAT_MASTER_NR
    int "Number of EtherCAT master"
    help
        Number of EtherCAT master (maximum 32)
    default 1

config OPENCN_ETHERCAT_MASTER_MAC0
    string "MAC address 0"
    help
        MAC address of the first EtherCAT master device
	The MAC address must match the regular expression
        "([0-9a-fA-F]{2}:){5}[0-9a-fA-F]{2}".

config OPENCN_ETHERCAT_MASTER_DEBUG_LEVEL
    int "Debug level"
    help
        Debug level of the EtherCAT master driver.
    default 0

config OPENCN_ETHERCAT_MASTER_MASTER_THREAD_PRIORITY
   int "Master thread priority"
   help
       RTDM priority of the master thread.
   default 50

config OPENCN_ETHERCAT_MASTER_EOE_THREAD_PRIORITY
   int "EOE thread priority"
   help
       RTDM priority of the EOE thread.
   default 50

config OPENCN_ETHERCAT_MASTER_EOE_THREAD_PERIOD_NS
   int "EOE thread period (ns)"
   help
       EOE thread period in nanoseconds.
   default 1000000
endif
```

## agency/linux/soo/Kconfig
```kconfig
menu "SOO Framework and subsystems"

config SOO_CORE_ASF
	bool "Enabling the security framework capabilities"
	depends on ARM_PSCI

config SOO_RT_APP
	bool "Simple RT application"
	help
		Simple app to try various things related to Cobalt API and others
	default Y

source "soo/dcm/Kconfig"
source "soo/soolink/Kconfig"
source "soo/drivers/Kconfig"

endmenu # SOO
```

## agency/linux/soo/dcm/Kconfig
```kconfig
config DCM_LZ4
	depends on LZ4_DECOMPRESS
	bool "DCM Compressor"
	help
		Compression and decompression of the MEs in the DCM
	default N
```

## agency/linux/soo/display_manager/Kconfig
```kconfig
menu "Display Manager"

source "soo/display_manager/local_interfaces/Kconfig"
source "soo/display_manager/me_interactions/Kconfig"

endmenu # Display Manager
```

## agency/linux/soo/display_manager/local_interfaces/Kconfig
```kconfig
menu "Local Interfaces"

config LOCAL_INTERFACES
	bool "Display test"
	help
		To be modified
	default N

endmenu # Local Interfaces
```

## agency/linux/soo/display_manager/me_interactions/Kconfig
```kconfig
menu "ME Interactions"

config ME_INTERACTIONS
	bool "Interaction Test"
	help
		To be modified
	default N

endmenu # ME Interactions
```

## agency/linux/soo/drivers/Kconfig
```kconfig
#
# SOO device configuration
#


menu "Smart Object Oriented subsystem" 

config VDUMMY_BACKEND
        bool "SOO (realtime and no-RT) vDummy support for debugging and testing"

config VUART_BACKEND
	bool "vuart UART Backend support for SOO Mobile Entity consoles"
	select SERIAL_CORE_CONSOLE
	
config VINPUT_BACKEND
    tristate "vinput input (keyboard/mouse) backend on SOO device"
    default n
    help
      This driver implements the backend of the input (keyboard/mouse) driver of the SOO environment.
	
config VDOGA12V6NM_BACKEND
	bool "vDOGA12V6NM backend"
	depends on TTY
	default n
	help
	  Support for DOGA 12V 6Nm blind motor.

config VWEATHER_BACKEND
	bool "vWeather backend"
	depends on TTY
	default n
	help
	  Support for multi-purpose weather station, for the SOO.outdoor
	  product.
	  
config VUIHANDLER_BACKEND
	bool "vUihandler backend driver"
	default N
	help
	  vUihandler backend driver for remote UI over Bluetooth or WLAN.
	  
config VLEDS_BACKEND
        bool "vleds LEDS backend driver"
        default N
        
config VFB_BACKEND
	tristate "vfb framebuffer backend driver"
	default n
	help
	  This driver enabled to deal with a virtualized interface for a framebuffer
	  in the Mobile Entity.

config VNET_BACKEND
    bool "vnet network access"
    default n
    help
      This driver implements the backend of the network driver of the SOO environment.

config VSENSELED_BACKEND
	depends on FB_RPISENSE || ARCH_VEXPRESS
	bool "vsenseled Sense-HAT led backend driver"
	default n
	help
	  The vsenseled driver enables 5 logical LEDs that may be used to represent the joystick movement
	  for example.

config VSENSEJ_BACKEND
	depends on FB_RPISENSE || ARCH_VEXPRESS
	bool "vsensej Sense-HAT joystick backend driver"
	default n
	help
	  The vsensej driver captures joystick movements.

config VWAGOLED_BACKEND
	bool "vwagoled wago led controller backend"
	default n
	help
	  The vwagoled driver allows to changes the status of the wago leds 
	  
config VIUOC_BACKEND
	bool "viuoc backend"
	default n
	help
	  The viuoc drivers allow to exchange information with IUOC server

config TCM515
	bool "Support tmc515 uart communication from kernel to provide EnOcean support"
	depends on SERIAL_DEV_CTRL_TTYPORT=y
	help
		Create an uart device that uses the serdev framework and allows 
		to communicate with a TCM515 en0cean module.

config VENOCEAN_BACKEND
	bool "enOcean backend driver"
	depends on TCM515=y
	default n
	help
	  This driver enabled to deal with a virtualized interface for the enOcean actuator.

config RN2483
	bool "Support rn2483 uart communication from kernel to provide LoRa support"
	depends on SERIAL_DEV_CTRL_TTYPORT=y
	help
		Create an uart device that uses the serdev framework and allows 
		to communicate with a RN2483 LoRa module.

config KBERRY838
	bool "Support kberry838 uart communication from kernel to provide KNX support"
	depends on SERIAL_DEV_CTRL_TTYPORT=y
	help
		Create an uart device that uses the serdev framework and allows 
		to communicate with a kberry838 KNX module.

config VKNX_BACKEND
	bool "KNX backend driver"
	depends on KBERRY838=y
	default n
	help
	  This driver enabled to deal with a virtualized interface for the KNX bus.

config MIPOT32001353
	bool "Support mipot 32001353 uart communication from kernel to provide LoRa support"
	depends on SERIAL_DEV_CTRL_TTYPORT=y
	help
		Create an uart device that uses the serdev framework and allows 
		to communicate with a Mipot 32001353 LoRa module.

source "soo/drivers/vnetback/Kconfig"

endmenu
	
```

## agency/linux/soo/soolink/plugins/Kconfig
```kconfig
#
# Network configuration
#

menu "Soolink plugins"

config SOOLINK_PLUGIN_WLAN
	bool "WLan plugin"
	help
		WLan plugin is used for wireless connection like 802.11 WIFI
	default N

config SOOLINK_PLUGIN_ETHERNET
	bool "Ethernet plugin"
	default N

config SOOLINK_PLUGIN_BLUETOOTH
	bool "Bluetooth plugin"
	depends on BT_RFCOMM
	help
		Bluetooth plugin is used for RFCOMM communications with a remote tablet/smartphone.
	default N

config SOOLINK_PLUGIN_LOOPBACK
	bool "Loopback plugin"
	help
		Loopback plugin is mainly used for debugging purposes, on Qemu environment typically
		or to do some send/receive scenarios with only one SOO device.
	default N

config SOOLINK_PLUGIN_SIMULATION
	bool "Simulation plugin"
	help
		Simulation plugin is used to simulate the network of smart objects.
		This plugin is used for debugging and validation purposes, helpful to
		study the behaviour of datalink protocols such as Winenet.
		
	default N

endmenu
 
```

## agency/rootfs/configs/rpi4_display_defconfig
```kconfig
BR2_arm=y
BR2_cortex_a72=y
BR2_ARM_FPU_NEON_VFPV4=y
BR2_SVN="svn"
BR2_KERNEL_MIRROR="https://www.kernel.org/pub"
BR2_GNU_MIRROR="http://ftp.gnu.org/pub/gnu"
BR2_CCACHE=y
BR2_TOOLCHAIN_EXTERNAL=y
BR2_TOOLCHAIN_EXTERNAL_CUSTOM=y
BR2_TOOLCHAIN_EXTERNAL_CUSTOM_PREFIX="arm-linux-gnueabihf"
BR2_TOOLCHAIN_EXTERNAL_GCC_6=y
BR2_TOOLCHAIN_EXTERNAL_HEADERS_4_6=y
BR2_TOOLCHAIN_EXTERNAL_CUSTOM_GLIBC=y
BR2_TOOLCHAIN_EXTERNAL_CXX=y
BR2_TARGET_GENERIC_HOSTNAME="agency"
BR2_TARGET_GENERIC_ISSUE="SOO Agency"
BR2_ROOTFS_DEVICE_CREATION_DYNAMIC_EUDEV=y
# BR2_TARGET_ENABLE_ROOT_LOGIN is not set
BR2_SYSTEM_BIN_SH_BASH=y
# BR2_TARGET_GENERIC_GETTY is not set
BR2_ENABLE_LOCALE_WHITELIST="C en_US de fr"
BR2_ROOTFS_OVERLAY="$(BASE_DIR)/board/common/rootfs_overlay/ $(BASE_DIR)/board/rpi4/rootfs_overlay/"
BR2_ROOTFS_POST_IMAGE_SCRIPT="$(BASE_DIR)/board/rpi4/post_image.sh"
BR2_PACKAGE_BUSYBOX_SHOW_OTHERS=y
BR2_PACKAGE_BUSYBOX_WATCHDOG=y
BR2_PACKAGE_FFMPEG=y
BR2_PACKAGE_FFMPEG_GPL=y
BR2_PACKAGE_FFMPEG_NONFREE=y
BR2_PACKAGE_FFMPEG_POSTPROC=y
BR2_PACKAGE_FFMPEG_SWSCALE=y
BR2_PACKAGE_BZIP2=y
BR2_PACKAGE_GZIP=y
BR2_PACKAGE_LZ4=y
BR2_PACKAGE_LZIP=y
BR2_PACKAGE_XZ=y
BR2_PACKAGE_ZIP=y
BR2_PACKAGE_CHECK=y
BR2_PACKAGE_GETTEXT=y
BR2_PACKAGE_DBUS_GLIB=y
BR2_PACKAGE_DBUS_PYTHON=y
BR2_PACKAGE_PICOCOM=y
BR2_PACKAGE_PERL=y
BR2_PACKAGE_PYTHON3=y
BR2_PACKAGE_PYTHON_PILLOW=y
BR2_PACKAGE_PYTHON_RPI_GPIO=y
BR2_PACKAGE_PYTHON_RPI_WS281X=y
BR2_PACKAGE_PYTHON_SENSE_HAT=y
BR2_PACKAGE_PYTHON_SETUPTOOLS=y
BR2_PACKAGE_LIBARCHIVE=y
BR2_PACKAGE_GNUTLS=y
BR2_PACKAGE_GNUTLS_OPENSSL=y
BR2_PACKAGE_BERKELEYDB=y
BR2_PACKAGE_MTDEV=y
BR2_PACKAGE_LIBXSLT=y
BR2_PACKAGE_LIBCURL=y
BR2_PACKAGE_LIBCURL_TLS_NONE=y
BR2_PACKAGE_LIBEVDEV=y
BR2_PACKAGE_BLUEZ5_UTILS=y
BR2_PACKAGE_BLUEZ5_UTILS_CLIENT=y
BR2_PACKAGE_BLUEZ5_UTILS_DEPRECATED=y
BR2_PACKAGE_BRIDGE_UTILS=y
BR2_PACKAGE_CRDA=y
BR2_PACKAGE_DHCP=y
BR2_PACKAGE_ETHTOOL=y
BR2_PACKAGE_IPERF3=y
BR2_PACKAGE_IPTABLES=y
BR2_PACKAGE_IW=y
BR2_PACKAGE_LINKS=y
BR2_PACKAGE_NETCAT=y
BR2_PACKAGE_WIRELESS_TOOLS=y
BR2_PACKAGE_WPA_SUPPLICANT=y
BR2_PACKAGE_WPA_SUPPLICANT_AUTOSCAN=y
BR2_PACKAGE_WPA_SUPPLICANT_DBUS=y
BR2_PACKAGE_WPA_SUPPLICANT_DBUS_INTROSPECTION=y
BR2_PACKAGE_OPTEE_CLIENT=y
BR2_PACKAGE_BASH_COMPLETION=y
BR2_PACKAGE_AUTO_GETTY_SUPPORT=y
BR2_PACKAGE_AUTO_GETTY=y
BR2_PACKAGE_AUTO_GETTY_ROOT_LOGIN=y
BR2_PACKAGE_UTIL_LINUX_LIBMOUNT=y
BR2_PACKAGE_UTIL_LINUX_LIBUUID=y
BR2_TARGET_ROOTFS_CPIO=y
# BR2_TARGET_ROOTFS_TAR is not set
BR2_PACKAGE_HOST_PYTHON3=y
BR2_PACKAGE_HOST_PYTHON3_SSL=y
```

## agency/target/merida/merida_blind.its
```
/*
 * Copyright (C) 2019 Daniel Rossier <daniel.rossier@soo.tech>
 *
 * This program is free software; you can redistribute it and/or modify
 * it under the terms of the GNU General Public License version 2 as
 * published by the Free Software Foundation.
 *
 * This program is distributed in the hope that it will be useful,
 * but WITHOUT ANY WARRANTY; without even the implied warranty of
 * MERCHANTABILITY or FITNESS FOR A PARTICULAR PURPOSE.  See the
 * GNU General Public License for more details.
 *
 * You should have received a copy of the GNU General Public License
 * along with this program; if not, write to the Free Software
 * Foundation, Inc., 51 Franklin St, Fifth Floor, Boston, MA  02110-1301  USA
 *
 */

/dts-v1/;

/ {
	description = "SOO Agency components for MERIDA board environment";
	#address-cells = <0>;
	#size-cells = <0>;

	images {
                #address-cells = <0>;
		#size-cells = <0>;
        
                avz {
			description = "AVZ Hypervisor (32-bit)";
                        data = /incbin/("../../avz/avz.bin");
			type = "kernel";
                        os = "linux";
			arch = "arm";
			compression = "none";
			load = <0x46008000>;
			entry = <0x46008000>;
		};

		agency {
			description = "Agency Linux kernel";
			data = /incbin/("../../linux/arch/arm/boot/Image");
			type = "kernel";
			arch = "arm";
			os = "linux";
			compression = "none";
			load = <0x46c08000>;
			entry = <0x46c08000>;
            
			#address-cells = <0>;
			#size-cells = <0>;

			hash {
				algo = "crc32";
			};
		};
			
       fdt {
			description = "SOO Agency device tree blob";
			data = /incbin/("../../linux/arch/arm/boot/dts/sun50i-a64-merida-blind.dtb");
			type = "flat_dt";
			arch = "arm";
			compression = "none";
			load = <0x4c000000>;
		
			hash {
				algo = "crc32";
			};
		};
	
		initrd {
			description = "Agency initial rootfs (initrd)";
			data = /incbin/("../../rootfs/board/merida/initrd.cpio");
			type = "ramdisk";
			arch = "arm";
			os = "linux";
			compression = "none";
			load = <0x4d000000>;
			hash {
				algo = "crc32";
			};
		};
	};
	
	configurations {
		default = "conf";
		conf {
			description = "SOO Agency on SOO.blind Smart Object";
                        loadables = "agency"; 
                        kernel = "avz";
                        fdt = "fdt"; 
                        ramdisk = "initrd"; 
		};
	};
};
```

## agency/target/rpi4/rpi4.its
```
/*
 * Copyright (C) 2019 Daniel Rossier <daniel.rossier@soo.tech>
 *
 * This program is free software; you can redistribute it and/or modify
 * it under the terms of the GNU General Public License version 2 as
 * published by the Free Software Foundation.
 *
 * This program is distributed in the hope that it will be useful,
 * but WITHOUT ANY WARRANTY; without even the implied warranty of
 * MERCHANTABILITY or FITNESS FOR A PARTICULAR PURPOSE.  See the
 * GNU General Public License for more details.
 *
 * You should have received a copy of the GNU General Public License
 * along with this program; if not, write to the Free Software
 * Foundation, Inc., 51 Franklin St, Fifth Floor, Boston, MA  02110-1301  USA
 *
 */

/dts-v1/;

/ {
	description = "SOO Agency components for Raspberry Pi 4 B environment";
	#address-cells = <0>;
	#size-cells = <0>;

	images {
                #address-cells = <0>;
		#size-cells = <0>;
        
                avz {
                        description = "AVZ Hypervisor (32-bit)";
                        data = /incbin/("../../avz/avz.bin");
                        type = "kernel";
                        os = "linux";
                        arch = "arm";
                        compression = "none";
                        load = <0x00008000>;
                        entry = <0x00008000>;
                };
        
                agency {
                        description = "Agency Linux kernel";
                        data = /incbin/("../../linux/arch/arm/boot/Image");
                        type = "kernel";
                        arch = "arm";
                        os = "linux";
                        compression = "none";
                        load = <0x00c08000>;
                        entry = <0x00c08000>;
                };

                fdt {
                        description = "SOO Agency device tree blob";
                        data = /incbin/("../../linux/arch/arm/boot/dts/bcm2711-rpi-4-b.dtb");
                        type = "flat_dt";
                        arch = "arm";
                        compression = "none";
                        load = <0x0a000000>;
                };
	
                initrd {
                        description = "Agency initial rootfs (initrd)";
                        data = /incbin/("../../rootfs/board/rpi4/initrd.cpio");
                        type = "ramdisk";
                        arch = "arm";
                        os = "linux";
                        compression = "none";
                        load = <0x0b000000>;
                };
        };
	
        configurations {
		default = "conf";
		conf {
			description = "SOO Agency on Raspberry Pi 4 B";
                        loadables = "agency";
                        kernel = "avz";
                        fdt = "fdt";
                        ramdisk = "initrd";
		};
	};
};
```
