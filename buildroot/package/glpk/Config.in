## buildroot/package/glpk/Config.in
```kconfig
config BR2_PACKAGE_GLPK
	bool "glpk"
	depends on BR2_PACKAGE_HOST_PKGCONF
	help
	  The GLPK (GNU Linear Programming Kit) package is intended for solving large-scale linear programming (LP),
	  mixed integer programming (MIP), and other related problems.

	  https://www.gnu.org/software/glpk/
```

## buildroot/package/python-rtimulib/Config.in
```kconfig
config BR2_PACKAGE_PYTHON_RTIMULIB
	bool "python-rtimulib"
	depends on BR2_PACKAGE_PYTHON3
	help
	  This module is basically used by the sense hat module
	  running on Raspberry Pi 4.
	  
	  https://github.com/RTIMULib/RTIMULib2

	  
```

## buildroot/package/python-sense-emu/Config.in
```kconfig
config BR2_PACKAGE_PYTHON_SENSE_EMU
	bool "python-sense-emu"
	depends on BR2_PACKAGE_PYTHON3
	select BR2_PACKAGE_PYTHON_RTIMULIB
	select BR2_PACKAGE_PYTHON_NUMPY
	help
	  This is the Sense Hat emulation support for Raspberry Pi 4.
	  
	  https://github.com/astro-pi/python-sense-emu

	  
	  
```

## buildroot/package/python-sense-hat/Config.in
```kconfig
config BR2_PACKAGE_PYTHON_SENSE_HAT
	bool "python-sense-hat"
	depends on BR2_PACKAGE_PYTHON3
	select BR2_PACKAGE_PYTHON_RTIMULIB
	select BR2_PACKAGE_PYTHON_NUMPY
	help
	  This is the Sense Hat support for Raspberry Pi 4.
	  
	  https://github.com/astro-pi/python-sense-hat

	  
	  
```

## linux/linux/soo/Kconfig
```kconfig
config SOO
	bool "Enabling the Smart Object Oriented (SOO) subsystem"
	select XENOMAI

if SOO
menu "SOO Framework and subsystems"

config SOO_CORE_ASF
	bool "Enabling the security framework capabilities"
	depends on ARM_PSCI

config SOO_RT_APP
	bool "Simple RT application"
	help
		Simple app to try various things related to Cobalt API and others
	default Y

source "soo/dcm/Kconfig"
source "soo/soolink/Kconfig"
source "soo/drivers/Kconfig"

endmenu # SOO

endif
```

## linux/linux/soo/drivers/vnetback/Kconfig
```kconfig
#
# SOO device configuration
#


menu "vnet backend config"

choice VNET_BACKEND_ARCH
    prompt "Backend architecture"
    depends on VNET_BACKEND
    default VNET_BACKEND_ARCH_BRIDGE

config VNET_BACKEND_ARCH_BRIDGE
    bool "Use bridge architectue"
    help
      All virtual interfaces are grouped in a single bridge with the outgoing interface (ex: eth0).

config VNET_BACKEND_ARCH_BRIDGE_AND_NAT
    bool "Use bridge and NAT architectue"
    help
        All virtual interfaces are grouped in a single bridge without the outgoing interface. A NAT give access to the internet.

config VNET_BACKEND_ARCH_NAT
    bool "Use NAT only architectue"
    help
        Each virtual interface has it's own network. Can't be used with migrant ME. A NAT give access to the internet.


endchoice

endmenu
```

## linux/linux/soo/kernel/debug/Kconfig
```kconfig
menuconfig VIRTSHARE_DEBUG
	default y
	bool "Virtshare debugging tools"

if VIRTSHARE_DEBUG



endif # VIRTSHARE_DEBUG
```

## target/bbb.its
```
/*
 * Copyright (C) 2020 Daniel Rossier <daniel.rossier@heig-vd.ch>
 *
 * This program is free software; you can redistribute it and/or modify
 * it under the terms of the GNU General Public License version 2 as
 * published by the Free Software Foundation.
 *
 * This program is distributed in the hope that it will be useful,
 * but WITHOUT ANY WARRANTY; without even the implied warranty of
 * MERCHANTABILITY or FITNESS FOR A PARTICULAR PURPOSE.  See the
 * GNU General Public License for more details.
 *
 * You should have received a copy of the GNU General Public License
 * along with this program; if not, write to the Free Software
 * Foundation, Inc., 51 Franklin St, Fifth Floor, Boston, MA  02110-1301  USA
 *
 */

/dts-v1/;

/ {
	description = "Kernel and rootfs components for BeagleBoneBlack environment";

	images {
		
		linux {
			description = "Linux kernel";
			data = /incbin/("../linux/linux/arch/arm/boot/zImage");
			type = "kernel";
			arch = "arm";
			os = "linux";
			compression = "none";
			load = <0x80008000>;
			entry = <0x80008000>;
		};

        fdt_linux {
			description = "Linux device tree blob";
			data = /incbin/("../linux/linux/arch/arm/boot/dts/am335x-boneblack.dtb");
			type = "flat_dt";
			arch = "arm";
			compression = "none";
			load = <0x88000000>; 
		};
	};
	
	configurations {
		default = "conf_linux";

		conf_linux {
			description = "Linux on BeagleBoneBlack";
            kernel = "linux";
            fdt = "fdt_linux";
		};
	};
};
```

## target/rpi4.its
```
/*
 * Copyright (C) 2019 Daniel Rossier <daniel.rossier@soo.tech>
 *
 * This program is free software; you can redistribute it and/or modify
 * it under the terms of the GNU General Public License version 2 as
 * published by the Free Software Foundation.
 *
 * This program is distributed in the hope that it will be useful,
 * but WITHOUT ANY WARRANTY; without even the implied warranty of
 * MERCHANTABILITY or FITNESS FOR A PARTICULAR PURPOSE.  See the
 * GNU General Public License for more details.
 *
 * You should have received a copy of the GNU General Public License
 * along with this program; if not, write to the Free Software
 * Foundation, Inc., 51 Franklin St, Fifth Floor, Boston, MA  02110-1301  USA
 *
 */

/dts-v1/;

/ {
	description = "SOO Agency components for Raspberry Pi 4 B environment";

	images {
        
   		avz {
        	description = "AVZ Hypervisor (32-bit)";
        	data = /incbin/("../avz/avz.bin");
        	type = "kernel";
        	os = "linux";
        	arch = "arm";
        	compression = "none";
        	load = <0x00008000>;
        	entry = <0x00008000>;
        };
        
		linux {
			description = "Agency Linux kernel";
			data = /incbin/("../linux/arch/arm/boot/Image");
			type = "agency";
			arch = "arm";
			os = "linux";
			compression = "none";
			load = <0x01008000>;
			entry = <0x01008000>;
		};

        fdt {
        	description = "SOO Agency device tree blob";
            data = /incbin/("../linux/arch/arm/boot/dts/bcm2711-rpi-4-b.dtb");
            type = "flat_dt";
            arch = "arm";
            compression = "none";
            load = <0x10a00000>;
        };
	
        initrd {
        	description = "Agency initial rootfs (initrd)";
            data = /incbin/("../rootfs/board/rpi4/initrd.cpio");
            type = "ramdisk";
            arch = "arm";
            os = "linux";
            compression = "none";
            load = <0x10c00000>;
        };
    };
	
    configurations {
		default = "agency_rpi4";
		agency_rpi4 {
			description = "SOO Agency on Raspberry Pi 4 B";
        	loadables = "linux";
        	kernel = "avz";
        	fdt = "fdt";
        	ramdisk = "initrd";
		};
	};
};
```

## target/virt64.its
```
/*
 * Copyright (C) 2020 Daniel Rossier <daniel.rossier@heig-vd.ch>
 *
 * This program is free software; you can redistribute it and/or modify
 * it under the terms of the GNU General Public License version 2 as
 * published by the Free Software Foundation.
 *
 * This program is distributed in the hope that it will be useful,
 * but WITHOUT ANY WARRANTY; without even the implied warranty of
 * MERCHANTABILITY or FITNESS FOR A PARTICULAR PURPOSE.  See the
 * GNU General Public License for more details.
 *
 * You should have received a copy of the GNU General Public License
 * along with this program; if not, write to the Free Software
 * Foundation, Inc., 51 Franklin St, Fifth Floor, Boston, MA  02110-1301  USA
 *
 */

/dts-v1/;

/ {
	description = "Kernel and rootfs components for virt64 (armv8) environment";

	images {

  		avz {
			description = "AVZ Hypervisor (64-bit) Polymorphic SO3";
            data = /incbin/("../avz/so3.bin");
			type = "kernel";
            os = "linux";
			arch = "arm64";
			compression = "none";
			load = <0x40080000>;
			entry = <0x40080000>;
		};

		linux {
			description = "Linux kernel";
			data = /incbin/("../linux/arch/arm64/boot/Image");
			type = "avz";
			arch = "arm64";
			os = "linux";
			compression = "none";
			load = <0x41000000>;
			entry = <0x41000000>;
		};

 		avz_pv_dt {
			description = "Flattened Device Tree blob";
			data = /incbin/("../avz/dts/virt64_avz_pv.dtb");
			type = "avz_dt";
			arch = "arm64";
			compression = "none";
			load = <0x40f00000>;
		};
        
         avz_vt_dt {
			description = "Flattened Device Tree blob";
			data = /incbin/("../avz/dts/virt64_avz_vt.dtb");
			type = "avz_dt";
			arch = "arm64";
			compression = "none";
			load = <0x40f00000>;
		};
		
        fdt {
			description = "Linux device tree blob";
			data = /incbin/("../linux/arch/arm64/boot/dts/arm/virt64.dtb");
			type = "flat_dt";
			arch = "arm64";
			compression = "none";
			load = <0x50000000>;
		};

		initrd {
			description = "Initial rootfs (initrd)";
			data = /incbin/("../rootfs/board/virt64/initrd.cpio");
			type = "ramdisk";
			arch = "arm64";
			os = "linux";			
			compression = "none";
			load = <0x50c00000>;
		};
	};

	configurations {
		default = "agency";
		
		agency {
			description = "SOO Agency on virt64";
		    kernel = "avz";
             loadables = "avz_pv_dt", "linux"; 
             fdt = "fdt"; 
             ramdisk = "initrd"; 
		};
		
	};

};
```
